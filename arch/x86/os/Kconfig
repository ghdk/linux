## arch/x86/os/Kconfig
```kconfig
menu "Operating System"

config GRUB_MODULES_PATH
	string "GRUB modules path"
	help
	  This is the absolute path where the GRUB modules live.

endmenu # "Operating System"
```

## drivers/os/Kconfig
```kconfig
menu "Operating System"

config OS_MODAPI_C
	tristate "Poke the Module API"
	default n
	help
	  A minimal module showcasing the module API.
endmenu # "Operating System"
```
